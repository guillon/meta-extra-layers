## meta-extra-python/conf/layer.conf
```bitbake
# We might have a conf and classes directory, append to BBPATH
BBPATH .= ":${LAYERDIR}"

# We have recipes directories, add to BBFILES
BBFILES += "${LAYERDIR}/recipes*/*/*.bb ${LAYERDIR}/recipes*/*/*.bbappend"

BBFILE_COLLECTIONS += "meta-extra-python"
BBFILE_PATTERN_meta-extra-python := "^${LAYERDIR}/"
BBFILE_PRIORITY_meta-extra-python = "7"

# This should only be incremented on significant changes that will
# cause compatibility issues with other layers
LAYERVERSION_meta-extra-python = "1"

LAYERDEPENDS_meta-extra-python = "core openembedded-layer"

LAYERSERIES_COMPAT_meta-extra-python = "thud warrior zeus"

LICENSE_PATH += "${LAYERDIR}/licenses"
```
